## boards/ecan/ecan_ecbt_uf2/board.yml
```yaml
# Copyright (c) 2024 Nordic Semiconductor ASA
# SPDX-License-Identifier: Apache-2.0

board:
  name: ecan_ecbt_uf2
  vendor: ecan
  socs:
    - name: nrf52840
```
